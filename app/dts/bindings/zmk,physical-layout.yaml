## app/dts/bindings/zmk,physical-layout.yaml
```yaml
description: "Physical layout for my 5x7 keyboard"
properties:
  label:
    description: "Pordesign"
    type: string
  rows:
    description: "5"
    type: integer
  columns:
    description: "7"
    type: integer
  transform:
    description: "Matrix transform node"
    type: phandle
  display-name:
    description: "Pordesign"
    type: string
    
required:
  - label
  - rows
  - columns
  - transform
  - display-name
```

## config/boards/shields/Pordesign_5x7/Kconfig.shield
```kconfig
menu "PorDesign 5x7 shield"
    config ZMK_SHIELD_PORDESIGN_5X7
        bool "PorDesign 5x7"
        default y
endmenu
```
